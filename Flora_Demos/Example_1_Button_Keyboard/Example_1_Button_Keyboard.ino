// Example of buttons generating keyboard presses
// Author: Tony DiCola
// License: Public Domain
#include <Keyboard.h>


#define BUTTON1_PIN  10                // Pin connected to button 1.

#define BUTTON2_PIN  12                // Pin connected to button 2.

#define BUTTON1_KEY  KEY_UP_ARROW      // Keyboard key generated by button 1 press.
                                       // See all the key values here:
                                       //   https://www.arduino.cc/en/Reference/KeyboardModifiers

#define BUTTON2_KEY  KEY_DOWN_ARROW    // Keyboard key generated by button 2 press.


void setup() {
  // Configure button inputs with a pullup resistor so they
  // default to a high level and are pulled down to ground
  // when pressed.
  pinMode(BUTTON1_PIN, INPUT_PULLUP);
  pinMode(BUTTON2_PIN, INPUT_PULLUP);
  // Initialize keyboard library.
  Keyboard.begin();
}

void loop() {
  // Look for the transition from high to low (button pressed)
  // or low to high (button released) to press and release keys.
  // Do this by taking an initial reading, waiting a tiny bit
  // and then taking another reading.  If there's a transition
  // we can detect the change between readings.  This also acts
  // to 'debouce' and prevent multiple transitions.
  int button1_first = digitalRead(BUTTON1_PIN);
  int button2_first = digitalRead(BUTTON2_PIN);
  delay(10);
  int button1_second = digitalRead(BUTTON1_PIN);
  int button2_second = digitalRead(BUTTON2_PIN);
  // Check for button transitions.
  if (button1_first == HIGH && button1_second == LOW) {
    // Button 1 was pressed.
    Keyboard.press(BUTTON1_KEY);
  }
  else if (button1_first == LOW && button1_second == HIGH) {
    // Button 1 was released.
    Keyboard.release(BUTTON1_KEY);
  }
  if (button2_first == HIGH && button2_second == LOW) {
    // Button 2 was pressed.
    Keyboard.press(BUTTON2_KEY);
  }
  else if (button2_first == LOW && button2_second == HIGH) {
    // Button 1 was released.
    Keyboard.release(BUTTON2_KEY);
  }
}

